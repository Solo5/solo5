ENTRY(_start)

SECTIONS {
    . = 0x100000;

    /* Code */
    _stext = .;

    .text :
    {
        *(.text)
        *(.text.*)
    }

#if defined(__powerpc64__)
    . = ALIGN(0x10000);
#else
    . = ALIGN(0x1000);
#endif
    _etext = .;

    /* Read-only data */
    .rodata :
    {
        *(.rodata)
        *(.rodata.*)
    }
    .eh_frame :
    {
        *(.eh_frame)
    }

#if defined(__powerpc64__)
    . = ALIGN(0x10000);
#else
    . = ALIGN(0x1000);
#endif
    _erodata = .;

    /* Read-write data (initialized) */
    .got :
    {
        *(.got.plt)
        *(.got)
    }
    .data :
    {
        *(.data)
        *(.data.*)
    }

#if defined(__powerpc64__)
    . = ALIGN(0x10000);
#else
    . = ALIGN(0x1000);
#endif
    _edata = .;

    /* Read-write data (uninitialized) */
    .bss :
    {
        *(.bss)
        *(COMMON)
    }

#if defined(__powerpc64__)
    . = ALIGN(0x10000);
#else
    . = ALIGN(0x1000);
#endif
    _ebss = .;
    _end = .;
}
